## main/Kconfig.projbuild
```kconfig
menu "Gamepad"

    choice GAMEPAD_MODEL
        prompt "Gamepad model"
        default GAMEPAD_DUALSHOCK4

        config GAMEPAD_DUALSENSE
            bool "Sony DualSense (PS5)"

        config GAMEPAD_DUALSHOCK4
            bool "Sony DualShock 4 (PS4)"

    endchoice

    config DUALSENSE_PEER_NAME
        string "DualSense Bluetooth device name prefix"
        default "DualSense Wireless Controller"
        help
            Bluetooth Classic device name prefix to match during discovery.
            A DualSense advertises "DualSense Wireless Controller".

    config DUALSHOCK4_PEER_NAME
        string "DualShock 4 Bluetooth device name prefix"
        default "Wireless Controller"
        help
            Bluetooth Classic device name prefix to match during discovery.
            A DualShock 4 advertises "Wireless Controller".

endmenu

menu "Host link (UART)"

    config HOSTLINK_UART_TX_GPIO
        int "Host-link UART TX GPIO"
        default 17
        help
            ESP32 GPIO used as the host-link UART TX line.

    config HOSTLINK_UART_RX_GPIO
        int "Host-link UART RX GPIO"
        default 16
        help
            ESP32 GPIO used as the host-link UART RX line.

    config HOSTLINK_UART_BAUDRATE
        int "Host-link UART baud rate"
        default 921600
        help
            Baud rate for the serial link to the host.

endmenu

menu "Encoder"

    choice ENCODER_MODEL
        prompt "Encoder model"
        default ENCODER_AS5600

        config ENCODER_AS5600
            bool "AS5600 (I2C) - FOC motor encoders"
            help
                Two AS5600 magnetic encoders on I2C buses 0 and 1, used as the
                FOC motor angle sensors (DengFOC V3P board).

        config ENCODER_AS5047P
            bool "AS5047P (SPI) rotary encoder"
            help
                A single AS5047P magnetic rotary encoder on SPI. Currently only a
                self-test is wired up; selecting this builds the SPI encoder
                module and runs the self-test instead of the gamepad/FOC path.

    endchoice

endmenu
```
